## west.yml
```yaml
manifest:
  remotes:
    - name: ncs
      url-base: https://github.com/nrfconnect
  projects:
    - name: nrf
      remote: ncs
      revision: v2.9.0   # Update to latest stable NCS version
      import: true
  self:
    path: app
```
